## firmware/esp32/main/Kconfig.projbuild
```kconfig
menu "Hermes Gadget"

    menu "Defaults (overridable from the serial console)"
        config HG_DEFAULT_NAME
            string "Device name"
            default "Hermes Gadget"
        config HG_DEFAULT_SERVER_URL
            string "Hermes gadget endpoint"
            default ""
            help
                ws://<hermes-host>:8765/gadget  (run 'hermes gadget info' on the host).
                Leave empty to configure it over serial: set server <url>
        config HG_DEFAULT_ACCESS_TOKEN
            string "Access token (only if GADGET_ACCESS_TOKEN is set on the host)"
            default ""
        config HG_DEFAULT_WIFI_SSID
            string "Wi-Fi SSID"
            default ""
        config HG_DEFAULT_WIFI_PASSWORD
            string "Wi-Fi password"
            default ""
    endmenu

    choice HG_BOARD
        prompt "Board"
        default HG_BOARD_ESP32S3_BREADBOARD
        help
            Pin maps and peripherals. Add a board: docs/porting.md

        config HG_BOARD_ESP32S3_BREADBOARD
            bool "ESP32-S3 breadboard (ST7789 + INMP441 + MAX98357A)"
        config HG_BOARD_AMOLED_175
            bool "Waveshare ESP32-S3-Touch-AMOLED-1.75 (round AMOLED, touch, codecs)"
        config HG_BOARD_AMOLED_175C
            bool "Waveshare ESP32-S3-Touch-AMOLED-1.75C (32 MB flash, enclosed AMOLED)"
        config HG_BOARD_BOX3
            bool "Espressif ESP32-S3-BOX-3 (LCD, touch, ES8311 + ES7210)"
        config HG_BOARD_CORES3
            bool "M5Stack CoreS3 (LCD, touch, AW88298 + ES7210)"
        config HG_BOARD_WS_ESP32S3_LCD_154
            bool "Waveshare ESP32-S3-LCD-1.54 (ST7789 240x240, ES8311 + ES7210 codecs)"
        config HG_BOARD_T_DISPLAY_S3
            bool "LilyGO T-Display-S3 (ST7789 320x170 on an i80 parallel bus, no audio)"
        config HG_BOARD_WS_ESP32C6_AMOLED_216
            bool "Waveshare ESP32-C6-Touch-AMOLED-2.16 (480x480 AMOLED, touch, codecs, no PSRAM)"
            depends on IDF_TARGET_ESP32C6
        config HG_BOARD_CUSTOM
            bool "Custom pins (configure below)"
    endchoice

    config HG_NVS_PARTITION
        string "NVS partition for the gadget's settings"
        default "nvs_hermes" if HG_BOARD_WS_ESP32C6_AMOLED_216
        default "nvs"
        help
            Boards that share flash with other apps keep their settings in a partition of
            their own. The gadget only ever erases this partition.

    config HG_OTA
        bool "Over-the-air firmware updates"
        default n if HG_BOARD_WS_ESP32C6_AMOLED_216
        default y
        help
            Updates go into the other app slot of partitions.csv. Off where the flash holds
            other apps, which the next slot could belong to.

    config HG_WS_MAX_MESSAGE_KB
        int "Largest WebSocket message the device reassembles (KiB)"
        default 32 if HG_BOARD_WS_ESP32C6_AMOLED_216
        default 512
        help
            A text message larger than this is dropped. Boards without PSRAM keep it small
            so a large message can't exhaust internal RAM.

    config HG_SPEAKER_BUFFER_KB
        int "Playback buffer in internal RAM when PSRAM is unavailable (KiB)"
        default 32 if HG_BOARD_WS_ESP32C6_AMOLED_216
        default 16

    config HG_EVENT_BYTES_KB
        int "Event payload bytes in flight before producers wait (KiB, 0 = no limit)"
        default 48 if HG_BOARD_WS_ESP32C6_AMOLED_216
        default 0

    config HG_MIC_CHUNK_MS
        int "Microphone audio per frame sent to Hermes (ms)"
        default 100 if HG_BOARD_WS_ESP32C6_AMOLED_216
        default 20
        range 20 200
        help
            Codec boards only. Fewer, larger WebSocket writes keep a slow-ACK link from
            filling the TCP send queue with small segments and stalling the app.

    config HG_WIFI_MODEM_SLEEP
        bool "Wi-Fi modem sleep between beacons"
        default n if HG_BOARD_WS_ESP32C6_AMOLED_216
        default y
        help
            Saves power, but the radio only hears the access point at DTIM beacons. On
            boards where that stalls the microphone upload, keep the radio awake.

    config HG_PLATFORM_APP_SWITCH
        bool "Runs as one app of the esp32-playground multi-app platform"
        default y if HG_BOARD_WS_ESP32C6_AMOLED_216
        default n
        help
            Holding BOOT for one second opens the platform launcher, and the app tells the
            platform bootloader once it started properly (its crash guard).

    menu "Custom board pins"
        depends on HG_BOARD_CUSTOM

        config HG_LCD_ENABLED
            bool "SPI LCD (ST7789)"
            default y
        config HG_LCD_WIDTH
            int "LCD width (after rotation)"
            default 320
            depends on HG_LCD_ENABLED
        config HG_LCD_HEIGHT
            int "LCD height (after rotation)"
            default 240
            depends on HG_LCD_ENABLED
        config HG_LCD_SWAP_XY
            bool "Landscape (swap X/Y)"
            default y
            depends on HG_LCD_ENABLED
        config HG_LCD_MIRROR_X
            bool "Mirror X"
            default y
            depends on HG_LCD_ENABLED
        config HG_LCD_MIRROR_Y
            bool "Mirror Y"
            default n
            depends on HG_LCD_ENABLED
        config HG_LCD_INVERT
            bool "Invert colours (most IPS ST7789 panels)"
            default y
            depends on HG_LCD_ENABLED
        config HG_LCD_GAP_X
            int "Column offset"
            default 0
            depends on HG_LCD_ENABLED
        config HG_LCD_GAP_Y
            int "Row offset"
            default 0
            depends on HG_LCD_ENABLED
        config HG_LCD_PIN_MOSI
            int "LCD MOSI"
            default 11
        config HG_LCD_PIN_SCLK
            int "LCD SCLK"
            default 12
        config HG_LCD_PIN_CS
            int "LCD CS"
            default 10
        config HG_LCD_PIN_DC
            int "LCD DC"
            default 9
        config HG_LCD_PIN_RST
            int "LCD RST (-1 if tied)"
            default 8
        config HG_LCD_PIN_BL
            int "LCD backlight (-1 if always on)"
            default 7
        config HG_LCD_SPI_MHZ
            int "LCD SPI clock (MHz)"
            default 40

        config HG_MIC_ENABLED
            bool "I2S microphone (INMP441-style, 24-bit left slot)"
            default y
        config HG_MIC_PIN_SCK
            int "Mic SCK/BCLK"
            default 4
        config HG_MIC_PIN_WS
            int "Mic WS/LRCLK"
            default 5
        config HG_MIC_PIN_SD
            int "Mic SD/DOUT"
            default 6

        config HG_SPK_ENABLED
            bool "I2S amplifier (MAX98357A-style)"
            default y
        config HG_SPK_PIN_BCLK
            int "Speaker BCLK"
            default 15
        config HG_SPK_PIN_WS
            int "Speaker LRC/WS"
            default 16
        config HG_SPK_PIN_DOUT
            int "Speaker DIN"
            default 17

        config HG_BTN_TALK
            int "Talk button GPIO (active low)"
            default 0
        config HG_BTN_CANCEL
            int "Cancel button GPIO (-1 = none)"
            default 14
        config HG_BTN_UP
            int "Scroll-up button GPIO (-1 = none)"
            default -1
        config HG_BTN_DOWN
            int "Scroll-down button GPIO (-1 = none)"
            default -1
        config HG_STATUS_LED
            int "Status LED GPIO, exposed to the agent as led.set (-1 = none)"
            default -1
    endmenu

endmenu
```
